## prj.conf
```kconfig
CONFIG_WIFI_ESP32=y
CONFIG_WIFI=y
CONFIG_NET_L2_WIFI_MGMT=y
CONFIG_NETWORKING=y
```

## src/main.c
```c
#include <zephyr/kernel.h>
#include <errno.h>

int main(void) {
	return 0;
}
```
